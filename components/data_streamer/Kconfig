## components/data_streamer/Kconfig
```kconfig
menu "Data streamer configuration"
    config DATA_STREAMER_CHUNK_SIZE
        int "Chunk size for streaming (bytes)"
        default 4096
        range 1024 32768
        help
            Size of chunks in chunked transfer encoding.
            Larger values use more memory but may improve performance.
            For larger values, you might have to tweak the server stack size in configuration.

    config DATA_STREAMER_MULTIPART_BOUNDARY
        string "Multipart boundary string"
        default "*~*-._.-*BOUNDARY*-._.-*~*"
        help
            Boundary string used in multipart/mixed responses.

endmenu
```

## main/Kconfig.projbuild
```kconfig
menu "Data Streamer example"
    config EXAMPLE_DATA_STREAMER_WIFI_SSID
        string "WiFi SSID"
        default "myssid"
        help
            SSID (network name) to connect to.

    config EXAMPLE_DATA_STREAMER_WIFI_PASS
        string "WiFi Password"
        default "mypassword"
        help
            WiFi password (WPA or WPA2) to use.

    config EXAMPLE_DATA_STREAMER_RETRY_MAX
        int "Max N retries for wifi connection"
        default 10
        help
            Max number of retries for wifi connection

    config EXAMPLE_DATA_STREAMER_HOSTNAME
        string "mDNS hostname"
        default "esp-host"
        help
            mDNS hostname (max 32 characters). If set to MAC, it will internally be translated to esp-<MAC of device>

    config EXAMPLE_DATA_STREAMER_FILE_PATH
        string "Single file path to stream"
        default ""
        help
            Path to the file that will be streamed. Leave empty to disable single file streaming.

    config EXAMPLE_DATA_STREAMER_DIR_PATH
        string "Directory path to stream"
        default ""
        help
            Path to the directory that will be streamed. Leave empty to disable directory streaming.

endmenu
```

## sdkconfig.defaults
```kconfig
CONFIG_ESP_SYSTEM_EVENT_TASK_STACK_SIZE=4096

CONFIG_LWIP_IRAM_OPTIMIZATION=y
CONFIG_LWIP_TCPIP_TASK_PRIO=23

CONFIG_SPIRAM=y
CONFIG_SPIRAM_MODE_OCT=y
CONFIG_ESPTOOLPY_FLASHSIZE_16MB=y

CONFIG_ESP_WIFI_STATIC_RX_BUFFER_NUM=16
CONFIG_ESP_WIFI_DYNAMIC_RX_BUFFER_NUM=64
CONFIG_ESP_WIFI_DYNAMIC_TX_BUFFER_NUM=64
CONFIG_ESP_WIFI_AMPDU_TX_ENABLED=y
CONFIG_ESP_WIFI_TX_BA_WIN=32
CONFIG_ESP_WIFI_AMPDU_RX_ENABLED=y
CONFIG_ESP_WIFI_RX_BA_WIN=32

CONFIG_LWIP_TCP_SND_BUF_DEFAULT=65535
CONFIG_LWIP_TCP_WND_DEFAULT=65535
CONFIG_LWIP_TCP_RECVMBOX_SIZE=64
CONFIG_LWIP_UDP_RECVMBOX_SIZE=64
CONFIG_LWIP_TCPIP_RECVMBOX_SIZE=64

CONFIG_ESP_DEFAULT_CPU_FREQ_MHZ_160=y
CONFIG_ESP_DEFAULT_CPU_FREQ_MHZ=160

# CONFIG_ESPTOOLPY_FLASHMODE_QIO=y
# CONFIG_ESPTOOLPY_FLASHFREQ_80M=y

CONFIG_ESP32S3_INSTRUCTION_CACHE_32KB=y
CONFIG_ESP32S3_INSTRUCTION_CACHE_LINE_32B=y
CONFIG_ESP32S3_INSTRUCTION_CACHE_WRAP=y

CONFIG_FATFS_LFN_STACK=y
CONFIG_FATFS_VFS_FSTAT_BLKSIZE=16384

CONFIG_ESP_TLS_PSK_VERIFICATION=y

CONFIG_DATA_STREAMER_CHUNK_SIZE=4096
# CONFIG_MAIN_TASK_STACK_SIZE=32000
CONFIG_PARTITION_TABLE_CUSTOM=y
CONFIG_PARTITION_TABLE_CUSTOM_FILENAME="partitions.csv"
CONFIG_PARTITION_TABLE_FILENAME="partitions.csv"
```
